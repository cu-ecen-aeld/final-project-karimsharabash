## conf/bblayers.conf
```bitbake
# POKY_BBLAYERS_CONF_VERSION is increased each time build/conf/bblayers.conf
# changes incompatibly
POKY_BBLAYERS_CONF_VERSION = "2"

BBPATH = "${TOPDIR}"
BBFILES ?= ""

BBLAYERS ?= " \
  /home/karim/git/final-project-karimsharabash/poky/meta \
  /home/karim/git/final-project-karimsharabash/poky/meta-poky \
  /home/karim/git/final-project-karimsharabash/poky/meta-yocto-bsp \
  /home/karim/git/final-project-karimsharabash/meta-raspberrypi \
  /home/karim/git/final-project-karimsharabash/meta-openembedded/meta-oe \
  /home/karim/git/final-project-karimsharabash/meta-openembedded/meta-python \
  /home/karim/git/final-project-karimsharabash/meta-openembedded/meta-networking \
  /home/karim/git/final-project-karimsharabash/meta-sws \
  "
```

## meta-sws/conf/layer.conf
```bitbake
BBPATH .= ":${LAYERDIR}"
BBFILES += "${LAYERDIR}/recipes-*/*.bb \
           ${LAYERDIR}/recipes-*/*/*.bb \
           ${LAYERDIR}/recipes-*/*/*.bbappend"

BBFILE_COLLECTIONS += "meta-sws"
BBFILE_PATTERN_meta-sws = "^${LAYERDIR}/"
BBFILE_PRIORITY_meta-sws = "6"
```
